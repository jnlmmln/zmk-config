## config/west.yml
```yaml
manifest:
  remotes:
    - name: custom_zmkfirmware
      url-base: https://github.com/a-wark
    - name: tri-state
      url-base: https://github.com/dhruvinsh
    - name: urob
      url-base: https://github.com/urob
  projects:
    - name: zmk
      remote: custom_zmkfirmware
      revision: studio
      import: app/west.yml
    - name: zmk-tri-state
      remote: tri-state
      revision: main
    - name: zmk-unicode
      remote: urob
      revision: v0.3 # set to same as ZMK version above
  self:
    path: config
```
